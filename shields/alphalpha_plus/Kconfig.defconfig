## shields/alphalpha_plus/Kconfig.defconfig
```kconfig
# Copyright (c) 2020 The ZMK Contributors
# SPDX-License-Identifier: MIT

if SHIELD_ALPHALPHA_PLUS

config ZMK_KEYBOARD_NAME
    default "ALPHALPHA_PLUS"

endif
```
